## west.yml
```yaml
manifest:
  group-filter:
  - -homekit
  - -find-my
  - -nrf-802154
  projects:
  - name: zephyr
    url: https://github.com/nrfconnect/sdk-zephyr
    revision: v2.6.99-ncs1
    west-commands: scripts/west-commands.yml
  - name: mcuboot
    url: https://github.com/nrfconnect/sdk-mcuboot
    revision: v1.7.99-ncs3
    path: bootloader/mcuboot
  - name: nrfxlib
    url: https://github.com/nrfconnect/sdk-nrfxlib
    revision: v1.7.0
  - name: trusted-firmware-m
    url: https://github.com/nrfconnect/sdk-trusted-firmware-m
    revision: v1.3.99-ncs2
    path: modules/tee/tfm
  - name: tfm-mcuboot
    url: https://github.com/nrfconnect/sdk-mcuboot
    revision: v1.7.2
    path: modules/tee/tfm-mcuboot
  - name: matter
    url: https://github.com/nrfconnect/sdk-connectedhomeip
    revision: v1.7.0
    path: modules/lib/matter
  - name: nrf-802154
    url: https://github.com/nrfconnect/sdk-nrf-802154
    revision: v1.7.0
    groups:
    - nrf-802154
  - name: cjson
    url: https://github.com/nrfconnect/sdk-cjson
    revision: 50bddddf7fb45e4ce87bc3619df06db55d181856
    path: modules/lib/cjson
  - name: openthread
    url: https://github.com/nrfconnect/sdk-openthread
    revision: 6e2ab99d68f5cd4c6ad5d728b7c7baadfcd22429
    path: modules/lib/openthread
  - name: cmock
    url: https://github.com/ThrowTheSwitch/cmock
    revision: 9d092898ef26ece140d9225e037274b64d4f851e
    path: test/cmock
  - name: unity
    url: https://github.com/ThrowTheSwitch/unity
    revision: 74cde089e65c3435ce9aa87d5c69f4f16b7f6ade
    path: test/cmock/vendor/unity
  - name: mbedtls-nrf
    url: https://github.com/ARMmbed/mbedtls
    revision: mbedtls-2.26.0
    path: mbedtls
  - name: Alexa-Gadgets-Embedded-Sample-Code
    url: https://github.com/alexa/Alexa-Gadgets-Embedded-Sample-Code
    revision: face92d8c62184832793f518bb1f19379538c5c1
    path: modules/alexa-embedded
  - name: mbed-cloud-client
    url: https://github.com/PelionIoT/mbed-cloud-client
    revision: 4.10.0
    path: modules/lib/pelion-dm
  - name: cddl-gen
    url: https://github.com/NordicSemiconductor/cddl-gen
    revision: 24f1b2b0c64c694b7f9ac1b7eab60b39236ca0bf
    path: modules/lib/cddl-gen
  - name: homekit
    url: https://github.com/nrfconnect/sdk-homekit
    revision: 1fe69ee38966b4eccc8909bf40c1e25941c54205
    groups:
    - homekit
  - name: find-my
    url: https://github.com/nrfconnect/sdk-find-my
    revision: v1.7.0
    groups:
    - find-my
  - name: memfault-firmware-sdk
    url: https://github.com/memfault/memfault-firmware-sdk
    revision: 0.25.0
    path: modules/lib/memfault-firmware-sdk
  - name: canopennode
    url: https://github.com/zephyrproject-rtos/canopennode
    revision: f167efe85c8c7de886f1bc47f9173cfb8a346bb5
    path: modules/lib/canopennode
  - name: civetweb
    url: https://github.com/zephyrproject-rtos/civetweb
    revision: 094aeb41bb93e9199d24d665ee43e9e05d6d7b1c
    path: modules/lib/civetweb
  - name: cmsis
    url: https://github.com/zephyrproject-rtos/cmsis
    revision: c3bd2094f92d574377f7af2aec147ae181aa5f8e
    path: modules/hal/cmsis
    groups:
    - hal
  - name: edtt
    url: https://github.com/zephyrproject-rtos/edtt
    revision: 7dd56fc100d79cc45c33d43e7401d1803e26f6e7
    path: tools/edtt
    groups:
    - tools
  - name: fatfs
    url: https://github.com/zephyrproject-rtos/fatfs
    revision: 1d1fcc725aa1cb3c32f366e0c53d7490d0fe1109
    path: modules/fs/fatfs
    groups:
    - fs
  - name: hal_nordic
    url: https://github.com/zephyrproject-rtos/hal_nordic
    revision: a6e5299041f152da5ae0ab17b2e44e088bb96d6d
    path: modules/hal/nordic
    groups:
    - hal
  - name: hal_st
    url: https://github.com/zephyrproject-rtos/hal_st
    revision: 575de9d461aa6f430cf62c58a053675377e700f3
    path: modules/hal/st
    groups:
    - hal
  - name: libmetal
    url: https://github.com/zephyrproject-rtos/libmetal
    revision: 39d049d4ae68e6f6d595fce7de1dcfc1024fb4eb
    path: modules/hal/libmetal
    groups:
    - hal
  - name: littlefs
    url: https://github.com/zephyrproject-rtos/littlefs
    revision: 9e4498d1c73009acd84bb36036ee5e2869112a6c
    path: modules/fs/littlefs
    groups:
    - fs
  - name: loramac-node
    url: https://github.com/zephyrproject-rtos/loramac-node
    revision: 12019623bbad9eb54fe51066847a7cbd4b4eac57
    path: modules/lib/loramac-node
  - name: lvgl
    url: https://github.com/zephyrproject-rtos/lvgl
    revision: 783c1f78c8e39751fe89d0883c8bce7336f55e94
    path: modules/lib/gui/lvgl
  - name: lz4
    url: https://github.com/zephyrproject-rtos/lz4
    revision: 8e303c264fc21c2116dc612658003a22e933124d
    path: modules/lib/lz4
  - name: mbedtls
    url: https://github.com/zephyrproject-rtos/mbedtls
    revision: 5765cb7f75a9973ae9232d438e361a9d7bbc49e7
    path: modules/crypto/mbedtls
    groups:
    - crypto
  - name: mcumgr
    url: https://github.com/zephyrproject-rtos/mcumgr
    revision: 657deb658e317ac2a5302675154b21f2666d5ec9
    path: modules/lib/mcumgr
  - name: mipi-sys-t
    url: https://github.com/zephyrproject-rtos/mipi-sys-t
    revision: 75e671550ac1acb502f315fe4952514dc73f7bfb
    path: modules/debug/mipi-sys-t
    groups:
    - debug
  - name: nanopb
    url: https://github.com/zephyrproject-rtos/nanopb
    revision: d148bd26718e4c10414f07a7eb1bd24c62e56c5d
    path: modules/lib/nanopb
  - name: net-tools
    url: https://github.com/zephyrproject-rtos/net-tools
    revision: f49bd1354616fae4093bf36e5eaee43c51a55127
    path: tools/net-tools
    groups:
    - tools
  - name: nrf_hw_models
    url: https://github.com/zephyrproject-rtos/nrf_hw_models
    revision: a47e326ca772ddd14cc3b9d4ca30a9ab44ecca16
    path: modules/bsim_hw_models/nrf_hw_models
  - name: open-amp
    url: https://github.com/zephyrproject-rtos/open-amp
    revision: 6010f0523cbc75f551d9256cf782f173177acdef
    path: modules/lib/open-amp
  - name: segger
    url: https://github.com/zephyrproject-rtos/segger
    revision: 3a52ab222133193802d3c3b4d21730b9b1f1d2f6
    path: modules/debug/segger
    groups:
    - debug
  - name: tinycbor
    url: https://github.com/zephyrproject-rtos/tinycbor
    revision: 40daca97b478989884bffb5226e9ab73ca54b8c4
    path: modules/lib/tinycbor
  - name: tinycrypt
    url: https://github.com/zephyrproject-rtos/tinycrypt
    revision: 3e9a49d2672ec01435ffbf0d788db6d95ef28de0
    path: modules/crypto/tinycrypt
    groups:
    - crypto
  - name: TraceRecorderSource
    url: https://github.com/zephyrproject-rtos/TraceRecorderSource
    revision: 5b5f8d7adbf0e93a09087e8f5708f0eebb8b25bf
    path: modules/debug/TraceRecorder
    groups:
    - debug
  self:
    path: nrf
    west-commands: scripts/west-commands.yml
```
